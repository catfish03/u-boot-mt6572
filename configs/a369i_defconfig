## configs/a369i_defconfig
```kconfig
### Commands
CONFIG_CMD_MMC=y
CONFIG_CMD_USB=y
CONFIG_CMD_BOOTD=y
CONFIG_CMD_BOOTM=y
CONFIG_CMD_BOOTZ=y
CONFIG_BOOTM_LINUX=y
CONFIG_CMD_BOOTMENU=y
CONFIG_CMD_FDT=y
CONFIG_CMD_GO=y
CONFIG_CMD_RUN=y
CONFIG_CMD_IMI=y
CONFIG_CMD_BDI=y
CONFIG_CMD_BDINFO_EXTRA=y
#CONFIG_CMD_UFETCH=y
CONFIG_CMD_DM=y
CONFIG_CMD_ENV=y
CONFIG_CMD_MEMINFO=y
CONFIG_CMD_MEMINFO_MAP=y
CONFIG_CMD_PAUSE=y


### Drivers
## Driver Model (DM)
CONFIG_DM_RESET=y
CONFIG_DM_MMC=y
CONFIG_DM_STDIO=y
CONFIG_DM_SERIAL=y
CONFIG_DM_USB=y
CONFIG_DM_PMIC=y
CONFIG_DM_REGULATOR=y
CONFIG_DM_REGULATOR_COMMON=y
CONFIG_DM_REGULATOR_FIXED=y
CONFIG_DM_KEYBOARD=y
CONFIG_DM_GPIO=y
## Simple Framebuffer / vidconsole
CONFIG_VIDEO=y
CONFIG_VIDEO_SIMPLE=y
CONFIG_BPP_16=y
CONFIG_VIDEO_ANSI=y
CONFIG_FDT_SIMPLEFB=y
CONFIG_VIDEO_LOGO=n
CONFIG_VIDEO_DT_SIMPLEFB=y
CONFIG_SYS_WHITE_ON_BLACK=y
CONFIG_NO_FB_CLEAR=y
## MSDC
CONFIG_MMC=y
CONFIG_MMC_WRITE=y
CONFIG_MMC_QUIRKS=y
CONFIG_MMC_HW_PARTITIONING=y
CONFIG_SUPPORT_EMMC_BOOT=y
# CONFIG_MMC_IO_VOLTAGE is not set
# CONFIG_MMC_HS400_ES_SUPPORT is not set
CONFIG_MMC_HS400_SUPPORT=y
CONFIG_MMC_HS200_SUPPORT=y
# CONFIG_MMC_DW is not set
# CONFIG_MMC_MXC is not set
CONFIG_MMC_SDHCI=y
CONFIG_MMC_MTK=y
## Input
CONFIG_INPUT=y
CONFIG_BUTTON=y
CONFIG_BUTTON_GPIO=y
CONFIG_BUTTON_KEYBOARD=y
CONFIG_BUTTON_REMAP_PHONE_KEYS=y
#CONFIG_BUTTON_MTK_PMIC=y
## Power / Reset
CONFIG_POWER=y
CONFIG_POWER_MT6323=y
CONFIG_MTK_POWER_DOMAIN=y
CONFIG_POWER_DOMAIN=y
CONFIG_RESET_MEDIATEK=y
CONFIG_RESET_SYSCON=y 
CONFIG_SYSRESET=y
CONFIG_SYSRESET_CMD_RESET=y
CONFIG_SYSRESET_WATCHDOG=y
## USB
CONFIG_USB=y
#CONFIG_USB_HOST=y
CONFIG_PHY=y
CONFIG_PHY_MTK_TPHY=y
#CONFIG_USB_MUSB_HOST=y
## Pinctrl
CONFIG_GPIO=y
CONFIG_PINCTRL=y
CONFIG_PINCTRL_FULL=y
CONFIG_PINCTRL_GENERIC=y
CONFIG_PINMUX=y
CONFIG_PINCONF=y
CONFIG_PINCONF_RECURSIVE=y
CONFIG_PINCTRL_MTK=y
CONFIG_PINCTRL_MT6572=y
## Clock
CONFIG_CLK=y
## Other
CONFIG_DMA=y
CONFIG_I2C=y
CONFIG_REGMAP=y
CONFIG_SYSCON=y
CONFIG_IOMMU=y
CONFIG_TIMER=y
CONFIG_MTK_TIMER=y
CONFIG_DRIVER_GICV2=y
## WDT
CONFIG_WATCHDOG=y
CONFIG_WATCHDOG_AUTOSTART=y
CONFIG_WDT=y
CONFIG_WDT_MTK=y
## PMIC
CONFIG_PMIC_CHILDREN=y
CONFIG_REGULATOR_MTK=y
CONFIG_MTK_PWRAP=y
CONFIG_MTK_PMIC=y
## UART
CONFIG_SERIAL=y
CONFIG_SERIAL_PRESENT=y
CONFIG_MTK_SERIAL=y
CONFIG_BAUDRATE=921600
CONFIG_REQUIRE_SERIAL_CONSOLE=y
CONFIG_DEBUG_UART_MTK=y
CONFIG_DEBUG_UART_SHIFT=0


### Build
## memetek
CONFIG_ARCH_MEDIATEK=y
CONFIG_TARGET_MT6572=y
CONFIG_BOARD_A369I=y
CONFIG_SYS_BOARD="a369i"
CONFIG_SYS_CONFIG_NAME="a369i"
CONFIG_SYS_SOC="mediatek"
CONFIG_SYS_VENDOR="lenovo"
## Other
CONFIG_TEXT_BASE=0x81e00000
CONFIG_POSITION_INDEPENDENT=y
CONFIG_HAS_CUSTOM_SYS_INIT_SP_ADDR=y
CONFIG_CUSTOM_SYS_INIT_SP_ADDR=0x81ffff10
CONFIG_LINUX_KERNEL_IMAGE_HEADER=y
CONFIG_ARM=y
CONFIG_SYS_ARCH="arm"
CONFIG_SYS_CPU="armv7"
CONFIG_CC_OPTIMIZE_FOR_SPEED=y
CONFIG_CC_OPTIMIZE_LIBS_FOR_SPEED=y
CONFIG_OPTIMIZE_INLINING=y
CONFIG_ARCH_SUPPORTS_LTO=y
CONFIG_CC_HAS_ASM_INLINE=y
CONFIG_DEFAULT_DEVICE_TREE="mt6572-lenovo-a369i"
CONFIG_DEFAULT_FDT_FILE="mt6572-lenovo-a369i.dtb"
CONFIG_CPU_V7A=y
CONFIG_SYS_ARM_ARCH=7
CONFIG_SYS_ARM_CACHE_WRITEBACK=y
CONFIG_SYS_THUMB_BUILD=y
CONFIG_USE_ARCH_MEMCPY=y
CONFIG_USE_ARCH_MEMSET=y
CONFIG_LOCALVERSION="-mt6572"


### Debugging / Logging
CONFIG_LOG=y
#CONFIG_LOG_DEFAULT_LEVEL=6
CONFIG_LOG_DEFAULT_LEVEL=7
CONFIG_LOGLEVEL=6
CONFIG_PANIC_HANG=y
#CONFIG_LOG_MAX_LEVEL=6
CONFIG_LOG_MAX_LEVEL=7
CONFIG_DEBUG_UART=y
CONFIG_DEBUG_UART_BASE=0x11005000
CONFIG_DEBUG_UART_CLOCK=26000000
CONFIG_DEBUG_UART_ANNOUNCE=y


### Menu
CONFIG_MENU=y
CONFIG_AUTOBOOT=y
#CONFIG_AUTOBOOT_MENU_SHOW=y
CONFIG_AUTOBOOT_KEYED=y


### Console
CONFIG_SYS_CONSOLE_IS_IN_ENV=y
CONFIG_LOG_CONSOLE=y
CONFIG_CONSOLE_MUX=y
CONFIG_CONSOLE_NORMAL=y


### Other
CONFIG_USE_DEFAULT_ENV_FILE=y
CONFIG_DEFAULT_ENV_FILE="board/lenovo/a369i/a369i.env"
CONFIG_HUSH_PARSER=y
CONFIG_SUPPORT_PASSING_ATAGS=y
CONFIG_MULTI_DTB_FIT_UNCOMPRESS_SZ=0x8000
CONFIG_CMDLINE=y
CONFIG_CMDLINE_EDITING=y
CONFIG_SYS_LONGHELP=y
CONFIG_SYS_PROMPT="U-Boot => "
CONFIG_SYS_PROMPT_HUSH_PS2="> "
CONFIG_SYS_MALLOC_LEN=0x2000000
CONFIG_SYS_MALLOC_F_LEN=0x8000
CONFIG_EXPERT=y
CONFIG_SYS_LOAD_ADDR=0x84000000
CONFIG_STACK_SIZE=0x1000000
CONFIG_HAS_VBAR=y
CONFIG_HAS_THUMB2=y
CONFIG_ARM_ASM_UNIFIED=y
CONFIG_SYS_ARM_CACHE_CP15=y
CONFIG_SYS_ARM_MMU=y


### Disabling unused stuff
CONFIG_NET=n
CONFIG_NO_NET=y
CONFIG_CMD_NET=n
CONFIG_EFI_LOADER=n
CONFIG_CMD_ACPI=n
CONFIG_PXE_UTILS=n
```
